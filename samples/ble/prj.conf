## CMakeLists.txt
```
# SPDX-License-Identifier: Apache-2.0
cmake_minimum_required(VERSION 3.20.0)

find_package(Zephyr REQUIRED HINTS $ENV{ZEPHYR_BASE})
project(improv_ble LANGUAGES C)

target_sources(app PRIVATE src/main.c)
```

## prj.conf
```kconfig
# Improv-WiFi BLE sample (Web Bluetooth). BLE-only: the serial transport is off.

# Improv module
CONFIG_IMPROV_WIFI=y
CONFIG_IMPROV_SERIAL=n
CONFIG_IMPROV_BLE=y

# Wi-Fi + networking
CONFIG_WIFI=y
CONFIG_NETWORKING=y
CONFIG_NET_IPV4=y
CONFIG_NET_IPV6=n
CONFIG_NET_DHCPV4=y
CONFIG_NET_MGMT=y
CONFIG_NET_MGMT_EVENT=y
CONFIG_NET_MGMT_EVENT_INFO=y
CONFIG_NET_L2_WIFI_MGMT=y

# Wi-Fi credentials library (persist + connect-stored on boot)
CONFIG_WIFI_NM=y
CONFIG_WIFI_CREDENTIALS=y
CONFIG_WIFI_CREDENTIALS_BACKEND_SETTINGS=y
CONFIG_WIFI_CREDENTIALS_CONNECT_STORED=y

# Persistence backend (NVS via the settings subsystem on storage_partition)
CONFIG_SETTINGS=y
CONFIG_FLASH=y
CONFIG_FLASH_MAP=y
CONFIG_NVS=y
CONFIG_SETTINGS_NVS=y

# Bluetooth peripheral
CONFIG_BT=y
CONFIG_BT_PERIPHERAL=y
CONFIG_BT_DEVICE_NAME="Zephyr Improv"
CONFIG_BT_MAX_CONN=1
CONFIG_BT_GATT_DYNAMIC_DB=y
CONFIG_BT_SETTINGS=y

# Raise the ATT MTU so a 64-byte PSK arrives in a single RPC-command write.
CONFIG_BT_L2CAP_TX_MTU=128
CONFIG_BT_BUF_ACL_RX_SIZE=132
CONFIG_BT_BUF_ACL_TX_SIZE=132

# Logging
CONFIG_LOG=y
CONFIG_LOG_DEFAULT_LEVEL=3

CONFIG_MAIN_STACK_SIZE=4096
CONFIG_SYSTEM_WORKQUEUE_STACK_SIZE=2048
```

## boards/esp32s3_devkitc_procpu.conf
```kconfig
# Headroom for the networking stacks on esp32s3 (the ESP32 Wi-Fi driver
# auto-enables and adds its own heap). Note: simultaneous Wi-Fi + BT on ESP32
# can be resource constrained.
CONFIG_NET_PKT_RX_COUNT=16
CONFIG_NET_PKT_TX_COUNT=16
CONFIG_NET_BUF_RX_COUNT=32
CONFIG_NET_BUF_TX_COUNT=32
```

## src/main.c
```c
/*
 * Improv-WiFi BLE provisioning sample.
 *
 * Brings up improv over a BLE GATT service. Provision with the Web Bluetooth
 * installer at https://www.improv-wifi.com/ble/.
 *
 * SPDX-License-Identifier: Apache-2.0
 */

#include <zephyr/kernel.h>

#include <improv/improv_wifi.h>

int main(void)
{
	improv_wifi_init();
	return 0;
}
```
