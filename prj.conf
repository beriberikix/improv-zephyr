## CMakeLists.txt
```
# SPDX-License-Identifier: Apache-2.0
#
# Zephyr module build entry for improv-zephyr. Sources are only compiled when the
# consuming application sets CONFIG_IMPROV_WIFI=y.

if(CONFIG_IMPROV_WIFI)
  zephyr_library()

  zephyr_include_directories(include)

  zephyr_library_sources(
    src/improv.c
    src/improv_handler.c
    src/improv_wifi.c
    src/wifi_prov.c
  )

  zephyr_library_sources_ifdef(CONFIG_IMPROV_SERIAL src/transport_serial.c)
  zephyr_library_sources_ifdef(CONFIG_IMPROV_BLE    src/transport_ble.c)
endif()
```

## Kconfig
```
# SPDX-License-Identifier: Apache-2.0
#
# Kconfig options for the improv-zephyr module. Sourced into the application's
# configuration tree by Zephyr's module system (see zephyr/module.yml).

config IMPROV_WIFI
	bool "Improv-WiFi provisioning protocol"
	help
	  Enable the improv-wifi provisioning protocol
	  (https://www.improv-wifi.com/). Provides a transport-agnostic state
	  machine plus serial and/or BLE transports and Zephyr Wi-Fi management
	  glue. Call improv_wifi_init() from your application.

if IMPROV_WIFI

config IMPROV_SERIAL
	bool "Improv serial transport"
	default y
	depends on SERIAL
	select UART_INTERRUPT_DRIVEN
	help
	  Listen for improv frames on the console UART (zephyr,console).
	  Compatible with the Web Serial installer at
	  https://www.improv-wifi.com/serial/.

config IMPROV_BLE
	bool "Improv BLE (GATT) transport"
	default n
	depends on BT_PERIPHERAL
	help
	  Expose the improv GATT service. Compatible with the Web Bluetooth
	  installer at https://www.improv-wifi.com/ble/. May be enabled alongside
	  the serial transport.

config IMPROV_REDIRECT_URL
	string "Redirect URL returned after successful provisioning"
	default ""
	help
	  URL returned as the first string of the Wi-Fi settings RPC result; the
	  installer shows it as a "Next" link. If it contains the token "{ip}" the
	  device's assigned IPv4 address is substituted. If left empty, the device
	  falls back to "http://<ip>/". Set to a single space to suppress the URL.

config IMPROV_FIRMWARE_NAME
	string "Firmware name (device info)"
	default "improv-zephyr"

config IMPROV_FIRMWARE_VERSION
	string "Firmware version (device info)"
	default "0.1.0"

config IMPROV_DEVICE_NAME
	string "Human readable device name (device info)"
	default "Zephyr Improv"

endif # IMPROV_WIFI
```

## west.yml
```
# West manifest for the standalone improv-zephyr Zephyr application (T2 topology).
#
# Usage (first time):
#   west init -l .          # run from inside this repo
#   west update             # fetches Zephyr + its modules (incl. hal_espressif)
#   west zephyr-export
#
# If you already have a Zephyr workspace with the esp32 HAL, you can instead
# build this app against that workspace without re-importing Zephyr (see README).
manifest:
  remotes:
    - name: zephyrproject-rtos
      url-base: https://github.com/zephyrproject-rtos

  projects:
    - name: zephyr
      remote: zephyrproject-rtos
      # Pin to a recent stable. Tested locally against Zephyr 4.x.
      revision: v4.1.0
      import:
        # Only pull the modules this app actually needs to keep the workspace
        # small. hal_espressif provides the esp32 Wi-Fi/BT blobs and drivers.
        name-allowlist:
          - hal_espressif
          - cmsis
          - mbedtls
          - segger

  self:
    path: improv-zephyr
```

## prj.conf
```kconfig
# Base configuration: improv over serial (default, tested with the JS Web Serial
# installer at https://www.improv-wifi.com/serial/). Enable BLE additionally with
# -DEXTRA_CONF_FILE=overlay-ble.conf.

# Improv transport
CONFIG_IMPROV_SERIAL=y

# Wi-Fi + networking
CONFIG_WIFI=y
CONFIG_NETWORKING=y
CONFIG_NET_IPV4=y
CONFIG_NET_IPV6=n
CONFIG_NET_DHCPV4=y
CONFIG_NET_MGMT=y
CONFIG_NET_MGMT_EVENT=y
CONFIG_NET_MGMT_EVENT_INFO=y
CONFIG_NET_L2_WIFI_MGMT=y

# Wi-Fi credentials library (persist + connect-stored on boot)
CONFIG_WIFI_NM=y
CONFIG_WIFI_CREDENTIALS=y
CONFIG_WIFI_CREDENTIALS_BACKEND_SETTINGS=y
CONFIG_WIFI_CREDENTIALS_CONNECT_STORED=y

# Persistence backend (NVS via the settings subsystem on storage_partition)
CONFIG_SETTINGS=y
CONFIG_FLASH=y
CONFIG_FLASH_MAP=y
CONFIG_NVS=y
CONFIG_SETTINGS_NVS=y

# Serial console (improv frames + logs share this UART; the IMPROV header lets the
# installer pick frames out of the log text). Shell is intentionally left off so it
# does not consume RX.
CONFIG_SERIAL=y
CONFIG_CONSOLE=y
CONFIG_UART_CONSOLE=y
CONFIG_UART_INTERRUPT_DRIVEN=y

# Optional identify LED
CONFIG_GPIO=y

# Logging
CONFIG_LOG=y
CONFIG_LOG_DEFAULT_LEVEL=3

CONFIG_MAIN_STACK_SIZE=4096
CONFIG_SYSTEM_WORKQUEUE_STACK_SIZE=2048
```

## overlay-ble.conf
```kconfig
# Overlay that adds the improv BLE (GATT) transport, compatible with the Web
# Bluetooth installer at https://www.improv-wifi.com/ble/.
#
# Use alongside the base prj.conf, e.g.:
#   west build -b esp32s3_devkitc/esp32s3/procpu . -- -DEXTRA_CONF_FILE=overlay-ble.conf
#
# This keeps the serial transport enabled as well (simultaneous mode). To build a
# BLE-only image, also set CONFIG_IMPROV_SERIAL=n.

CONFIG_IMPROV_BLE=y

CONFIG_BT=y
CONFIG_BT_PERIPHERAL=y
CONFIG_BT_DEVICE_NAME="Zephyr Improv"
CONFIG_BT_MAX_CONN=1
CONFIG_BT_GATT_DYNAMIC_DB=y
CONFIG_BT_SETTINGS=y

# Raise the ATT MTU so a 64-byte PSK arrives in a single RPC-command write.
CONFIG_BT_L2CAP_TX_MTU=128
CONFIG_BT_BUF_ACL_RX_SIZE=132
CONFIG_BT_BUF_ACL_TX_SIZE=132
```

## boards/esp32s3_devkitc_procpu.conf
```kconfig
# Board-specific tuning for esp32s3_devkitc. The ESP32 Wi-Fi driver auto-enables
# (CONFIG_WIFI_ESP32) and adds its own heap (HEAP_MEM_POOL_ADD_SIZE_ESP_WIFI), so
# most defaults are fine. Headroom is added here for the networking stacks.

CONFIG_NET_PKT_RX_COUNT=16
CONFIG_NET_PKT_TX_COUNT=16
CONFIG_NET_BUF_RX_COUNT=32
CONFIG_NET_BUF_TX_COUNT=32
```

## src/main.c
```c
/*
 * main.c - Improv-WiFi provisioning for Zephyr.
 *
 * Wires the Wi-Fi management layer, the improv state machine, and the enabled
 * transports together. JS-over-Serial is the default and primary path; BLE is
 * built in when CONFIG_IMPROV_BLE is set.
 *
 * SPDX-License-Identifier: Apache-2.0
 */

#include <zephyr/kernel.h>
#include <zephyr/logging/log.h>

#if defined(CONFIG_SETTINGS)
#include <zephyr/settings/settings.h>
#endif

#include "improv_handler.h"
#include "improv_transport.h"
#include "wifi_prov.h"

LOG_MODULE_REGISTER(improv_main, LOG_LEVEL_INF);

int main(void)
{
	LOG_INF("Improv-WiFi for Zephyr starting (board: %s)", CONFIG_BOARD);

#if defined(CONFIG_SETTINGS)
	/* Load persisted Wi-Fi credentials before attempting connect-stored. */
	settings_subsys_init();
	settings_load();
#endif

	/* Registers net_mgmt callbacks and starts a connect attempt with any
	 * stored credentials.
	 */
	wifi_prov_init();

	/* Initial improv state reflects whether Wi-Fi is already up. */
	improv_handler_init();

	int err = improv_serial_init();

	if (err) {
		LOG_ERR("serial transport init failed: %d", err);
	}

	err = improv_ble_init();
	if (err) {
		LOG_ERR("BLE transport init failed: %d", err);
	}

	LOG_INF("Improv-WiFi ready");
	return 0;
}
```

## src/improv.c
```c
/*
 * improv.c - Improv-WiFi protocol core implementation.
 *
 * Faithful C port of github.com/improv-wifi/sdk-cpp src/improv.cpp.
 *
 * SPDX-License-Identifier: Apache-2.0
 */

#include <improv/improv.h>

#include <string.h>

static const uint8_t improv_header[6] = {'I', 'M', 'P', 'R', 'O', 'V'};

uint8_t improv_checksum(const uint8_t *data, size_t len)
{
	uint32_t sum = 0;

	for (size_t i = 0; i < len; i++) {
		sum += data[i];
	}

	return (uint8_t)(sum & 0xFF);
}

bool improv_parse_rpc(const uint8_t *data, size_t length, bool check_checksum,
		      struct improv_rpc *out)
{
	memset(out, 0, sizeof(*out));

	/* Need at least the command and data-length bytes. */
	if (length < 2) {
		out->command = IMPROV_CMD_UNKNOWN;
		return false;
	}

	enum improv_command command = (enum improv_command)data[0];
	uint8_t data_length = data[1];

	/* data_length counts the payload after the two header bytes, excluding
	 * the optional trailing checksum byte.
	 */
	if (data_length != length - 2 - (check_checksum ? 1 : 0)) {
		out->command = IMPROV_CMD_UNKNOWN;
		return false;
	}

	if (check_checksum) {
		uint8_t expected = data[length - 1];

		if (improv_checksum(data, length - 1) != expected) {
			out->command = IMPROV_CMD_BAD_CHECKSUM;
			return false;
		}
	}

	if (command == IMPROV_CMD_WIFI_SETTINGS) {
		uint8_t ssid_length = data[2];
		size_t ssid_start = 3;
		size_t ssid_end = ssid_start + ssid_length;

		if (ssid_end > length) {
			out->command = IMPROV_CMD_UNKNOWN;
			return false;
		}

		uint8_t pass_length = data[ssid_end];
		size_t pass_start = ssid_end + 1;
		size_t pass_end = pass_start + pass_length;

		if (pass_end > length) {
			out->command = IMPROV_CMD_UNKNOWN;
			return false;
		}

		if (ssid_length > IMPROV_MAX_SSID_LEN ||
		    pass_length > IMPROV_MAX_PASSWORD_LEN) {
			out->command = IMPROV_CMD_UNKNOWN;
			return false;
		}

		memcpy(out->ssid, &data[ssid_start], ssid_length);
		out->ssid[ssid_length] = '\0';
		out->ssid_len = ssid_length;

		memcpy(out->password, &data[pass_start], pass_length);
		out->password[pass_length] = '\0';
		out->password_len = pass_length;
	}

	out->command = command;
	return true;
}

enum improv_parse_result improv_serial_feed(struct improv_serial_parser *p, uint8_t byte,
					    struct improv_rpc *cmd, enum improv_error *err)
{
	/* Defensive: never index past the buffer. */
	if (p->pos >= IMPROV_SERIAL_BUFFER_SIZE) {
		p->pos = 0;
	}

	size_t pos = p->pos;

	p->buffer[pos] = byte;

	bool ok;

	if (pos < 6) {
		ok = (byte == improv_header[pos]);
	} else if (pos == 6) {
		ok = (byte == IMPROV_SERIAL_VERSION);
	} else if (pos <= 8) {
		/* pos 7 = type, pos 8 = data length: always accepted. */
		ok = true;
	} else {
		uint8_t data_len = p->buffer[8];

		if (pos < 9 + (size_t)data_len) {
			/* Still reading the payload. */
			ok = true;
		} else {
			/* This byte is the checksum (pos == 9 + data_len). */
			uint8_t calc = improv_checksum(p->buffer, pos);

			if (calc != byte) {
				p->pos = 0;
				*err = IMPROV_ERROR_INVALID_RPC;
				return IMPROV_PARSE_ERROR;
			}

			enum improv_serial_type type =
				(enum improv_serial_type)p->buffer[7];

			p->pos = 0;

			if (type == IMPROV_TYPE_RPC) {
				/* Payload begins at index 9; no embedded checksum. */
				improv_parse_rpc(&p->buffer[9], data_len, false, cmd);
				return IMPROV_PARSE_RPC_READY;
			}

			/* Non-RPC frames from the host are ignored. */
			return IMPROV_PARSE_INCOMPLETE;
		}
	}

	if (!ok) {
		p->pos = 0;
		return IMPROV_PARSE_INCOMPLETE;
	}

	p->pos = pos + 1;
	return IMPROV_PARSE_INCOMPLETE;
}

size_t improv_build_rpc(enum improv_command command, const struct improv_str *strings,
			size_t n_strings, bool add_checksum, uint8_t *out, size_t out_size)
{
	/* command(1) + datalen(1) + sum(len byte + bytes) + optional checksum(1). */
	size_t needed = 2 + (add_checksum ? 1 : 0);

	for (size_t i = 0; i < n_strings; i++) {
		needed += 1 + strings[i].len;
	}

	if (needed > out_size) {
		return 0;
	}

	out[0] = (uint8_t)command;

	size_t pos = 2;

	for (size_t i = 0; i < n_strings; i++) {
		out[pos++] = strings[i].len;
		memcpy(&out[pos], strings[i].data, strings[i].len);
		pos += strings[i].len;
	}

	out[1] = (uint8_t)(pos - 2);

	if (add_checksum) {
		out[pos] = improv_checksum(out, pos);
		pos++;
	}

	return pos;
}

size_t improv_wrap_serial(enum improv_serial_type type, const uint8_t *payload,
			  size_t payload_len, uint8_t *out, size_t out_size)
{
	/* header(6) + version(1) + type(1) + len(1) + payload + checksum(1). */
	size_t total = 10 + payload_len;

	if (payload_len > 255 || total > out_size) {
		return 0;
	}

	memcpy(out, improv_header, sizeof(improv_header));
	out[6] = IMPROV_SERIAL_VERSION;
	out[7] = (uint8_t)type;
	out[8] = (uint8_t)payload_len;
	memcpy(&out[9], payload, payload_len);
	out[9 + payload_len] = improv_checksum(out, 9 + payload_len);

	return total;
}
```

## src/improv.h
```c
/*
 * improv.h - Improv-WiFi protocol core (transport agnostic).
 *
 * A C port of the official C++ SDK (github.com/improv-wifi/sdk-cpp). It contains
 * only the wire-format logic: enums, checksums, the streaming serial parser, the
 * RPC payload parser, and the response/serial-frame builders. It has no
 * dependency on Zephyr, Wi-Fi, or any transport so it can be unit tested or
 * reused as-is.
 *
 * SPDX-License-Identifier: Apache-2.0
 */

#ifndef IMPROV_H_
#define IMPROV_H_

#include <stdbool.h>
#include <stddef.h>
#include <stdint.h>

#ifdef __cplusplus
extern "C" {
#endif

#define IMPROV_SERIAL_VERSION 1

/* Wi-Fi field limits (1 length byte each, plus our buffer ceilings). */
#define IMPROV_MAX_SSID_LEN     32
#define IMPROV_MAX_PASSWORD_LEN 64

/* Capability bitmask advertised over BLE. */
#define IMPROV_CAPABILITY_IDENTIFY 0x01

/* Largest serial frame: 6 (IMPROV) + 1 ver + 1 type + 1 len + 255 payload + 1 cksum. */
#define IMPROV_SERIAL_BUFFER_SIZE 265

enum improv_error {
	IMPROV_ERROR_NONE = 0x00,
	IMPROV_ERROR_INVALID_RPC = 0x01,
	IMPROV_ERROR_UNKNOWN_RPC = 0x02,
	IMPROV_ERROR_UNABLE_TO_CONNECT = 0x03,
	IMPROV_ERROR_NOT_AUTHORIZED = 0x04,
	IMPROV_ERROR_UNKNOWN = 0xFF,
};

enum improv_state {
	IMPROV_STATE_STOPPED = 0x00,
	IMPROV_STATE_AWAITING_AUTHORIZATION = 0x01,
	IMPROV_STATE_AUTHORIZED = 0x02,
	IMPROV_STATE_PROVISIONING = 0x03,
	IMPROV_STATE_PROVISIONED = 0x04,
};

enum improv_command {
	IMPROV_CMD_UNKNOWN = 0x00,
	IMPROV_CMD_WIFI_SETTINGS = 0x01,
	/* 0x02 is both IDENTIFY and GET_CURRENT_STATE in the protocol. Over serial
	 * the client sends it (with zero payload) to request the current state.
	 */
	IMPROV_CMD_GET_CURRENT_STATE = 0x02,
	IMPROV_CMD_GET_DEVICE_INFO = 0x03,
	IMPROV_CMD_GET_WIFI_NETWORKS = 0x04,
	IMPROV_CMD_BAD_CHECKSUM = 0xFF,
};

enum improv_serial_type {
	IMPROV_TYPE_CURRENT_STATE = 0x01,
	IMPROV_TYPE_ERROR_STATE = 0x02,
	IMPROV_TYPE_RPC = 0x03,
	IMPROV_TYPE_RPC_RESPONSE = 0x04,
};

/* A parsed RPC command. ssid/password are only populated for WIFI_SETTINGS and
 * are NUL-terminated for convenience.
 */
struct improv_rpc {
	enum improv_command command;
	uint8_t ssid[IMPROV_MAX_SSID_LEN + 1];
	uint8_t ssid_len;
	uint8_t password[IMPROV_MAX_PASSWORD_LEN + 1];
	uint8_t password_len;
};

/* A length-prefixed string used when building RPC responses. */
struct improv_str {
	const uint8_t *data;
	uint8_t len;
};

/* Streaming parser state for the serial transport. Zero-initialize before use. */
struct improv_serial_parser {
	uint8_t buffer[IMPROV_SERIAL_BUFFER_SIZE];
	size_t pos;
};

enum improv_parse_result {
	IMPROV_PARSE_INCOMPLETE = 0, /* Need more bytes. */
	IMPROV_PARSE_RPC_READY,      /* A complete RPC frame was parsed into *cmd. */
	IMPROV_PARSE_ERROR,          /* Frame error; *err holds the improv error. */
};

/* 8-bit additive checksum of the first @len bytes of @data. */
uint8_t improv_checksum(const uint8_t *data, size_t len);

/*
 * Parse an RPC payload (command byte, data-length byte, then payload).
 * @check_checksum: if true, the final byte is validated as a checksum (BLE).
 *                  if false, no checksum is present (serial, already validated).
 * Returns true on a well-formed command; on failure returns false and sets
 * out->command to IMPROV_CMD_UNKNOWN or IMPROV_CMD_BAD_CHECKSUM.
 */
bool improv_parse_rpc(const uint8_t *data, size_t length, bool check_checksum,
		      struct improv_rpc *out);

/*
 * Feed one received byte to the streaming serial parser.
 * Returns IMPROV_PARSE_RPC_READY with *cmd filled when a full RPC frame arrives,
 * IMPROV_PARSE_ERROR with *err set on a checksum/format error, or
 * IMPROV_PARSE_INCOMPLETE otherwise.
 */
enum improv_parse_result improv_serial_feed(struct improv_serial_parser *p, uint8_t byte,
					    struct improv_rpc *cmd, enum improv_error *err);

/*
 * Build an RPC response body: command, total data length, then each string
 * length-prefixed. If @add_checksum, an 8-bit checksum byte is appended.
 * Returns the number of bytes written to @out, or 0 if @out_size is too small.
 */
size_t improv_build_rpc(enum improv_command command, const struct improv_str *strings,
			size_t n_strings, bool add_checksum, uint8_t *out, size_t out_size);

/*
 * Wrap a payload in a complete serial frame:
 *   "IMPROV" + version + type + length + payload + checksum.
 * Returns total bytes written to @out, or 0 if @out_size is too small.
 */
size_t improv_wrap_serial(enum improv_serial_type type, const uint8_t *payload,
			  size_t payload_len, uint8_t *out, size_t out_size);

#ifdef __cplusplus
}
#endif

#endif /* IMPROV_H_ */
```

## src/improv_handler.c
```c
/*
 * improv_handler.c - Improv state machine and RPC command dispatch.
 *
 * SPDX-License-Identifier: Apache-2.0
 */

#include "improv_handler.h"

#include <stdio.h>
#include <string.h>

#include <zephyr/kernel.h>
#include <zephyr/logging/log.h>

#include <improv/improv.h>
#include "wifi_prov.h"

LOG_MODULE_REGISTER(improv_handler, LOG_LEVEL_INF);

#define MAX_TRANSPORTS 2

/* If DHCP has not produced an IP this long after association, send the Wi-Fi
 * settings response anyway (using the configured URL without IP substitution).
 */
#define IP_WAIT_TIMEOUT K_SECONDS(10)

static improv_send_fn transports[MAX_TRANSPORTS];
static size_t transport_count;

static enum improv_state current_state = IMPROV_STATE_AUTHORIZED;
static enum improv_error current_error = IMPROV_ERROR_NONE;

/* Set while a client-initiated WIFI_SETTINGS flow is awaiting its IP so we know
 * to emit the RPC response (vs. a background auto-connect on boot).
 */
static bool awaiting_provision_result;

static void ip_timeout_handler(struct k_work *work);
static K_WORK_DELAYABLE_DEFINE(ip_timeout_work, ip_timeout_handler);

/* ---- low level send helpers ---------------------------------------------- */

static void broadcast(enum improv_serial_type type, const uint8_t *payload, size_t len)
{
	for (size_t i = 0; i < transport_count; i++) {
		transports[i](type, payload, len);
	}
}

static void send_current_state(void)
{
	uint8_t b = (uint8_t)current_state;

	broadcast(IMPROV_TYPE_CURRENT_STATE, &b, 1);
}

static void send_error(enum improv_error err)
{
	uint8_t b = (uint8_t)err;

	current_error = err;
	broadcast(IMPROV_TYPE_ERROR_STATE, &b, 1);
}

static void set_state(enum improv_state state)
{
	current_state = state;
	send_current_state();
}

/* ---- RPC responses ------------------------------------------------------- */

/* Build the redirect URL from CONFIG_IMPROV_REDIRECT_URL, substituting "{ip}"
 * or, when the configured URL is empty, defaulting to "http://<ip>/".
 */
static size_t build_redirect_url(char *buf, size_t buf_len)
{
	const char *tmpl = CONFIG_IMPROV_REDIRECT_URL;
	char ip[16];
	bool have_ip = wifi_prov_get_ip(ip, sizeof(ip));

	/* A single space means "explicitly no URL". */
	if (tmpl[0] == ' ' && tmpl[1] == '\0') {
		return 0;
	}

	if (tmpl[0] == '\0') {
		if (!have_ip) {
			return 0;
		}
		return snprintf(buf, buf_len, "http://%s/", ip);
	}

	const char *token = strstr(tmpl, "{ip}");

	if (token == NULL) {
		return snprintf(buf, buf_len, "%s", tmpl);
	}

	/* Substitute the first {ip} occurrence. */
	size_t prefix = (size_t)(token - tmpl);

	return snprintf(buf, buf_len, "%.*s%s%s", (int)prefix, tmpl,
			have_ip ? ip : "", token + strlen("{ip}"));
}

static void send_wifi_settings_response(void)
{
	char url[96];
	uint8_t payload[128];
	struct improv_str strings[1];
	size_t n = 0;

	size_t url_len = build_redirect_url(url, sizeof(url));

	if (url_len > 0 && url_len < sizeof(url)) {
		strings[0].data = (const uint8_t *)url;
		strings[0].len = (uint8_t)url_len;
		n = 1;
	}

	size_t len = improv_build_rpc(IMPROV_CMD_WIFI_SETTINGS, strings, n, false,
				      payload, sizeof(payload));

	if (len > 0) {
		broadcast(IMPROV_TYPE_RPC_RESPONSE, payload, len);
	}
}

static void send_device_info(void)
{
	const char *fw_name = CONFIG_IMPROV_FIRMWARE_NAME;
	const char *fw_version = CONFIG_IMPROV_FIRMWARE_VERSION;
	const char *chip = CONFIG_BOARD;
	const char *dev_name = CONFIG_IMPROV_DEVICE_NAME;

	struct improv_str strings[4] = {
		{ (const uint8_t *)fw_name, (uint8_t)strlen(fw_name) },
		{ (const uint8_t *)fw_version, (uint8_t)strlen(fw_version) },
		{ (const uint8_t *)chip, (uint8_t)strlen(chip) },
		{ (const uint8_t *)dev_name, (uint8_t)strlen(dev_name) },
	};
	uint8_t payload[160];

	size_t len = improv_build_rpc(IMPROV_CMD_GET_DEVICE_INFO, strings,
				      ARRAY_SIZE(strings), false, payload, sizeof(payload));

	if (len > 0) {
		broadcast(IMPROV_TYPE_RPC_RESPONSE, payload, len);
	}
}

/* ---- Wi-Fi scan -> RPC responses ----------------------------------------- */

static void scan_result(const char *ssid, int8_t rssi, bool secured)
{
	char rssi_str[8];
	uint8_t payload[64];

	snprintf(rssi_str, sizeof(rssi_str), "%d", rssi);

	struct improv_str strings[3] = {
		{ (const uint8_t *)ssid, (uint8_t)strlen(ssid) },
		{ (const uint8_t *)rssi_str, (uint8_t)strlen(rssi_str) },
		{ (const uint8_t *)(secured ? "YES" : "NO"), (uint8_t)(secured ? 3 : 2) },
	};

	size_t len = improv_build_rpc(IMPROV_CMD_GET_WIFI_NETWORKS, strings,
				      ARRAY_SIZE(strings), false, payload, sizeof(payload));

	if (len > 0) {
		broadcast(IMPROV_TYPE_RPC_RESPONSE, payload, len);
	}
}

static void scan_done(void)
{
	/* An empty RPC response terminates the network list. */
	uint8_t payload[8];
	size_t len = improv_build_rpc(IMPROV_CMD_GET_WIFI_NETWORKS, NULL, 0, false,
				      payload, sizeof(payload));

	if (len > 0) {
		broadcast(IMPROV_TYPE_RPC_RESPONSE, payload, len);
	}
}

/* ---- command dispatch ---------------------------------------------------- */

static void handle_wifi_settings(const struct improv_rpc *cmd)
{
	LOG_INF("WIFI_SETTINGS for SSID '%s'", (const char *)cmd->ssid);

	set_state(IMPROV_STATE_PROVISIONING);
	current_error = IMPROV_ERROR_NONE;
	awaiting_provision_result = true;

	int ret = wifi_prov_connect(cmd->ssid, cmd->ssid_len, cmd->password,
				    cmd->password_len);

	if (ret != 0) {
		LOG_ERR("connect request failed: %d", ret);
		awaiting_provision_result = false;
		send_error(IMPROV_ERROR_UNABLE_TO_CONNECT);
		set_state(IMPROV_STATE_AUTHORIZED);
	}
}

void improv_handler_on_command(const struct improv_rpc *cmd)
{
	switch (cmd->command) {
	case IMPROV_CMD_WIFI_SETTINGS:
		handle_wifi_settings(cmd);
		break;

	case IMPROV_CMD_GET_CURRENT_STATE:
		send_current_state();
		/* If already provisioned, (re)send the redirect URL result. */
		if (current_state == IMPROV_STATE_PROVISIONED) {
			send_wifi_settings_response();
		}
		break;

	case IMPROV_CMD_GET_DEVICE_INFO:
		send_device_info();
		break;

	case IMPROV_CMD_GET_WIFI_NETWORKS:
		if (wifi_prov_scan(scan_result, scan_done) != 0) {
			scan_done();
		}
		break;

	case IMPROV_CMD_BAD_CHECKSUM:
		send_error(IMPROV_ERROR_INVALID_RPC);
		break;

	default:
		LOG_WRN("unknown command 0x%02x", cmd->command);
		send_error(IMPROV_ERROR_UNKNOWN_RPC);
		break;
	}
}

void improv_handler_on_rpc_bytes(const uint8_t *data, size_t len)
{
	struct improv_rpc cmd;

	/* BLE carries the checksum-suffixed RPC body. */
	improv_parse_rpc(data, len, true, &cmd);
	improv_handler_on_command(&cmd);
}

/* ---- Wi-Fi result hooks -------------------------------------------------- */

void improv_handler_on_connect_result(bool success)
{
	if (success) {
		LOG_INF("Wi-Fi connected");
		set_state(IMPROV_STATE_PROVISIONED);

		if (awaiting_provision_result) {
			/* Wait for DHCP to provide an IP for the redirect URL,
			 * but don't wait forever.
			 */
			k_work_reschedule(&ip_timeout_work, IP_WAIT_TIMEOUT);
		}
	} else {
		LOG_WRN("Wi-Fi connect failed");
		if (awaiting_provision_result) {
			awaiting_provision_result = false;
			send_error(IMPROV_ERROR_UNABLE_TO_CONNECT);
		}
		set_state(IMPROV_STATE_AUTHORIZED);
	}
}

void improv_handler_on_got_ip(const char *ip_str)
{
	LOG_INF("Got IP %s", ip_str);

	if (current_state != IMPROV_STATE_PROVISIONED) {
		set_state(IMPROV_STATE_PROVISIONED);
	}

	if (awaiting_provision_result) {
		awaiting_provision_result = false;
		k_work_cancel_delayable(&ip_timeout_work);
		send_wifi_settings_response();
	}
}

static void ip_timeout_handler(struct k_work *work)
{
	ARG_UNUSED(work);

	if (awaiting_provision_result) {
		LOG_WRN("DHCP timed out; sending response without IP");
		awaiting_provision_result = false;
		send_wifi_settings_response();
	}
}

void improv_handler_report_error(enum improv_error err)
{
	send_error(err);
}

void improv_handler_register_transport(improv_send_fn fn)
{
	if (transport_count < MAX_TRANSPORTS) {
		transports[transport_count++] = fn;
	}
}

enum improv_state improv_handler_get_state(void)
{
	return current_state;
}

uint8_t improv_handler_get_error(void)
{
	return (uint8_t)current_error;
}

void improv_handler_init(void)
{
	if (wifi_prov_is_connected()) {
		current_state = IMPROV_STATE_PROVISIONED;
	} else {
		current_state = IMPROV_STATE_AUTHORIZED;
	}
	current_error = IMPROV_ERROR_NONE;
}
```

## src/improv_handler.h
```c
/*
 * improv_handler.h - Transport-agnostic improv state machine and RPC dispatch.
 *
 * SPDX-License-Identifier: Apache-2.0
 */

#ifndef IMPROV_HANDLER_H_
#define IMPROV_HANDLER_H_

#include <stddef.h>
#include <stdint.h>

#include <improv/improv.h>
#include "improv_transport.h"

/* Initialise the handler. Sets the initial state to PROVISIONED if Wi-Fi is
 * already connected (e.g. auto-connect from stored credentials), else AUTHORIZED.
 */
void improv_handler_init(void);

/* Register a transport send callback. Up to two transports (serial + BLE) may be
 * active simultaneously; all registered transports receive every message.
 */
void improv_handler_register_transport(improv_send_fn fn);

/* Current state accessor (used by the BLE transport for the state characteristic). */
enum improv_state improv_handler_get_state(void);
uint8_t improv_handler_get_error(void);

/* Dispatch a fully-parsed RPC command (used by the serial transport). */
void improv_handler_on_command(const struct improv_rpc *cmd);

/* Emit an error-state message (e.g. a serial frame checksum failure). */
void improv_handler_report_error(enum improv_error err);

/* Parse a raw RPC payload (command, len, ..., checksum) then dispatch it (used by
 * the BLE transport, whose characteristic carries the checksum-suffixed body).
 */
void improv_handler_on_rpc_bytes(const uint8_t *data, size_t len);

/* Wi-Fi result hooks, called from the Wi-Fi management layer. */
void improv_handler_on_connect_result(bool success);
void improv_handler_on_got_ip(const char *ip_str);

#endif /* IMPROV_HANDLER_H_ */
```

## src/improv_transport.h
```c
/*
 * improv_transport.h - Interface between the protocol handler and transports.
 *
 * A transport (serial, BLE) registers a send callback with the handler. The
 * handler emits "logical" messages as a (type, payload) pair; each transport
 * renders them appropriately: the serial transport wraps them in an IMPROV
 * frame, the BLE transport notifies the matching characteristic.
 *
 * SPDX-License-Identifier: Apache-2.0
 */

#ifndef IMPROV_TRANSPORT_H_
#define IMPROV_TRANSPORT_H_

#include <stddef.h>
#include <stdint.h>

#include <improv/improv.h>

/* Sends a logical improv message. @payload is the un-framed body:
 *  - IMPROV_TYPE_CURRENT_STATE / IMPROV_TYPE_ERROR_STATE: a single state/error byte
 *  - IMPROV_TYPE_RPC_RESPONSE: an RPC response body (command, len, strings...)
 */
typedef void (*improv_send_fn)(enum improv_serial_type type, const uint8_t *payload,
			       size_t payload_len);

/* Transport initialisers. Each registers its send callback with the handler.
 * Stubbed out by the build when the corresponding transport is disabled.
 */
#if defined(CONFIG_IMPROV_SERIAL)
int improv_serial_init(void);
#else
static inline int improv_serial_init(void)
{
	return 0;
}
#endif

#if defined(CONFIG_IMPROV_BLE)
int improv_ble_init(void);
#else
static inline int improv_ble_init(void)
{
	return 0;
}
#endif

#endif /* IMPROV_TRANSPORT_H_ */
```

## src/improv_wifi.c
```c
/*
 * improv_wifi.c - Module entry point: wire Wi-Fi, the state machine, and the
 * enabled transports together behind a single improv_wifi_init() call.
 *
 * SPDX-License-Identifier: Apache-2.0
 */

#include <improv/improv_wifi.h>

#include <zephyr/kernel.h>
#include <zephyr/logging/log.h>

#if defined(CONFIG_SETTINGS)
#include <zephyr/settings/settings.h>
#endif

#include "improv_handler.h"
#include "improv_transport.h"
#include "wifi_prov.h"

LOG_MODULE_REGISTER(improv_wifi, LOG_LEVEL_INF);

int improv_wifi_init(void)
{
	int err;
	int ret = 0;

#if defined(CONFIG_SETTINGS)
	/* Load persisted Wi-Fi credentials before attempting connect-stored. */
	settings_subsys_init();
	settings_load();
#endif

	/* Registers net_mgmt callbacks and starts a connect attempt with any
	 * stored credentials.
	 */
	wifi_prov_init();

	/* Initial improv state reflects whether Wi-Fi is already up. */
	improv_handler_init();

	err = improv_serial_init();
	if (err) {
		LOG_ERR("serial transport init failed: %d", err);
		ret = err;
	}

	err = improv_ble_init();
	if (err) {
		LOG_ERR("BLE transport init failed: %d", err);
		ret = err;
	}

	LOG_INF("improv-zephyr ready (board: %s)", CONFIG_BOARD);
	return ret;
}
```

## src/transport_ble.c
```c
/*
 * transport_ble.c - Improv BLE (GATT) transport.
 *
 * Exposes the improv GATT service so the Web Bluetooth installer at
 * https://www.improv-wifi.com/ble/ can provision the device. Unlike the serial
 * transport there is no IMPROV frame wrapper: each logical message maps to a
 * GATT characteristic (current state, error state, RPC command, RPC result).
 *
 * SPDX-License-Identifier: Apache-2.0
 */

#include <string.h>

#include <zephyr/bluetooth/bluetooth.h>
#include <zephyr/bluetooth/conn.h>
#include <zephyr/bluetooth/gatt.h>
#include <zephyr/bluetooth/uuid.h>
#include <zephyr/kernel.h>
#include <zephyr/logging/log.h>

#include <improv/improv.h>
#include "improv_handler.h"
#include "improv_transport.h"

LOG_MODULE_REGISTER(improv_ble, LOG_LEVEL_INF);

/* Base UUID 00467768-6228-2272-4663-2774782680xx; the last byte selects the
 * service (00) and each characteristic (01..05).
 */
#define IMPROV_UUID(last) BT_UUID_128_ENCODE(0x00467768, 0x6228, 0x2272, 0x4663, 0x2774782680##last)

static const struct bt_uuid_128 service_uuid = BT_UUID_INIT_128(IMPROV_UUID(00));
static const struct bt_uuid_128 status_uuid = BT_UUID_INIT_128(IMPROV_UUID(01));
static const struct bt_uuid_128 error_uuid = BT_UUID_INIT_128(IMPROV_UUID(02));
static const struct bt_uuid_128 rpc_cmd_uuid = BT_UUID_INIT_128(IMPROV_UUID(03));
static const struct bt_uuid_128 rpc_result_uuid = BT_UUID_INIT_128(IMPROV_UUID(04));
static const struct bt_uuid_128 capabilities_uuid = BT_UUID_INIT_128(IMPROV_UUID(05));

/* esp32s3_devkitc has no simple LED, so identify is not advertised. */
static const uint8_t capabilities_value;

/* Last RPC result so a GATT read (vs. notify) returns the current value. */
static uint8_t rpc_result_buf[IMPROV_SERIAL_BUFFER_SIZE];
static size_t rpc_result_len;

/* Deferred dispatch of a received RPC command (keeps net_mgmt off the BT thread). */
static uint8_t rpc_cmd_buf[IMPROV_SERIAL_BUFFER_SIZE];
static size_t rpc_cmd_len;
static void rpc_work_handler(struct k_work *work);
static K_WORK_DEFINE(rpc_work, rpc_work_handler);

static ssize_t read_state(struct bt_conn *conn, const struct bt_gatt_attr *attr, void *buf,
			  uint16_t len, uint16_t offset)
{
	uint8_t v = (uint8_t)improv_handler_get_state();

	return bt_gatt_attr_read(conn, attr, buf, len, offset, &v, sizeof(v));
}

static ssize_t read_error(struct bt_conn *conn, const struct bt_gatt_attr *attr, void *buf,
			  uint16_t len, uint16_t offset)
{
	uint8_t v = improv_handler_get_error();

	return bt_gatt_attr_read(conn, attr, buf, len, offset, &v, sizeof(v));
}

static ssize_t read_capabilities(struct bt_conn *conn, const struct bt_gatt_attr *attr, void *buf,
				 uint16_t len, uint16_t offset)
{
	return bt_gatt_attr_read(conn, attr, buf, len, offset, &capabilities_value,
				 sizeof(capabilities_value));
}

static ssize_t read_rpc_result(struct bt_conn *conn, const struct bt_gatt_attr *attr, void *buf,
			       uint16_t len, uint16_t offset)
{
	return bt_gatt_attr_read(conn, attr, buf, len, offset, rpc_result_buf, rpc_result_len);
}

static ssize_t write_rpc_cmd(struct bt_conn *conn, const struct bt_gatt_attr *attr, const void *buf,
			     uint16_t len, uint16_t offset, uint8_t flags)
{
	ARG_UNUSED(conn);
	ARG_UNUSED(attr);
	ARG_UNUSED(flags);

	if (offset != 0) {
		return BT_GATT_ERR(BT_ATT_ERR_INVALID_OFFSET);
	}
	if (len > sizeof(rpc_cmd_buf)) {
		return BT_GATT_ERR(BT_ATT_ERR_INVALID_ATTRIBUTE_LEN);
	}

	memcpy(rpc_cmd_buf, buf, len);
	rpc_cmd_len = len;
	k_work_submit(&rpc_work);

	return len;
}

/* Attribute layout (indexes into improv_svc.attrs used by bt_gatt_notify):
 *  0 service
 *  1 status decl, 2 status value, 3 status CCC
 *  4 error decl, 5 error value, 6 error CCC
 *  7 rpc-cmd decl, 8 rpc-cmd value
 *  9 rpc-result decl, 10 rpc-result value, 11 rpc-result CCC
 * 12 capabilities decl, 13 capabilities value
 */
BT_GATT_SERVICE_DEFINE(improv_svc,
	BT_GATT_PRIMARY_SERVICE(&service_uuid),
	BT_GATT_CHARACTERISTIC(&status_uuid.uuid, BT_GATT_CHRC_READ | BT_GATT_CHRC_NOTIFY,
			       BT_GATT_PERM_READ, read_state, NULL, NULL),
	BT_GATT_CCC(NULL, BT_GATT_PERM_READ | BT_GATT_PERM_WRITE),
	BT_GATT_CHARACTERISTIC(&error_uuid.uuid, BT_GATT_CHRC_READ | BT_GATT_CHRC_NOTIFY,
			       BT_GATT_PERM_READ, read_error, NULL, NULL),
	BT_GATT_CCC(NULL, BT_GATT_PERM_READ | BT_GATT_PERM_WRITE),
	BT_GATT_CHARACTERISTIC(&rpc_cmd_uuid.uuid, BT_GATT_CHRC_WRITE, BT_GATT_PERM_WRITE,
			       NULL, write_rpc_cmd, NULL),
	BT_GATT_CHARACTERISTIC(&rpc_result_uuid.uuid, BT_GATT_CHRC_READ | BT_GATT_CHRC_NOTIFY,
			       BT_GATT_PERM_READ, read_rpc_result, NULL, NULL),
	BT_GATT_CCC(NULL, BT_GATT_PERM_READ | BT_GATT_PERM_WRITE),
	BT_GATT_CHARACTERISTIC(&capabilities_uuid.uuid, BT_GATT_CHRC_READ, BT_GATT_PERM_READ,
			       read_capabilities, NULL, NULL),
);

#define ATTR_STATE      (&improv_svc.attrs[2])
#define ATTR_ERROR      (&improv_svc.attrs[5])
#define ATTR_RPC_RESULT (&improv_svc.attrs[10])

static void rpc_work_handler(struct k_work *work)
{
	ARG_UNUSED(work);

	improv_handler_on_rpc_bytes(rpc_cmd_buf, rpc_cmd_len);
}

static void ble_send(enum improv_serial_type type, const uint8_t *payload, size_t payload_len)
{
	switch (type) {
	case IMPROV_TYPE_CURRENT_STATE:
		bt_gatt_notify(NULL, ATTR_STATE, payload, payload_len);
		break;
	case IMPROV_TYPE_ERROR_STATE:
		bt_gatt_notify(NULL, ATTR_ERROR, payload, payload_len);
		break;
	case IMPROV_TYPE_RPC_RESPONSE:
		if (payload_len <= sizeof(rpc_result_buf)) {
			memcpy(rpc_result_buf, payload, payload_len);
			rpc_result_len = payload_len;
			bt_gatt_notify(NULL, ATTR_RPC_RESULT, payload, payload_len);
		}
		break;
	default:
		break;
	}
}

static const struct bt_data ad[] = {
	BT_DATA_BYTES(BT_DATA_FLAGS, BT_LE_AD_GENERAL | BT_LE_AD_NO_BREDR),
	BT_DATA_BYTES(BT_DATA_UUID128_ALL, IMPROV_UUID(00)),
};

static const struct bt_data sd[] = {
	BT_DATA(BT_DATA_NAME_COMPLETE, CONFIG_BT_DEVICE_NAME, sizeof(CONFIG_BT_DEVICE_NAME) - 1),
};

static void bt_ready(int err)
{
	if (err) {
		LOG_ERR("Bluetooth init failed: %d", err);
		return;
	}

	err = bt_le_adv_start(BT_LE_ADV_CONN_FAST_1, ad, ARRAY_SIZE(ad), sd, ARRAY_SIZE(sd));
	if (err) {
		LOG_ERR("advertising failed to start: %d", err);
		return;
	}

	LOG_INF("improv BLE transport advertising");
}

int improv_ble_init(void)
{
	improv_handler_register_transport(ble_send);

	int err = bt_enable(bt_ready);

	if (err) {
		LOG_ERR("bt_enable failed: %d", err);
	}

	return err;
}
```

## src/transport_serial.c
```c
/*
 * transport_serial.c - Improv serial transport over the console UART.
 *
 * Listens for improv frames on zephyr,console using the interrupt-driven UART
 * API and writes framed responses back. Compatible with the Web Serial installer
 * at https://www.improv-wifi.com/serial/. Incoming bytes are parsed in the RX
 * ISR (cheap, pure computation) and completed commands are handed to a worker
 * thread so that blocking work (Wi-Fi connect, logging) runs in thread context.
 *
 * SPDX-License-Identifier: Apache-2.0
 */

#include <errno.h>

#include <zephyr/device.h>
#include <zephyr/drivers/uart.h>
#include <zephyr/kernel.h>
#include <zephyr/logging/log.h>

#include <improv/improv.h>
#include "improv_handler.h"
#include "improv_transport.h"

LOG_MODULE_REGISTER(improv_serial, LOG_LEVEL_INF);

#define WORKER_STACK_SIZE 2048
#define WORKER_PRIORITY   7

static const struct device *const uart_dev = DEVICE_DT_GET(DT_CHOSEN(zephyr_console));

static struct improv_serial_parser parser;
static struct k_mutex tx_lock;

/* Carries a parsed command (or an error) from the RX ISR to the worker thread. */
struct serial_msg {
	bool is_error;
	enum improv_error err;
	struct improv_rpc cmd;
};

K_MSGQ_DEFINE(serial_msgq, sizeof(struct serial_msg), 4, 4);

static void serial_send(enum improv_serial_type type, const uint8_t *payload, size_t payload_len)
{
	uint8_t frame[IMPROV_SERIAL_BUFFER_SIZE];
	size_t n = improv_wrap_serial(type, payload, payload_len, frame, sizeof(frame));

	if (n == 0) {
		LOG_ERR("frame too large (type %u, len %zu)", type, payload_len);
		return;
	}

	k_mutex_lock(&tx_lock, K_FOREVER);
	for (size_t i = 0; i < n; i++) {
		uart_poll_out(uart_dev, frame[i]);
	}
	k_mutex_unlock(&tx_lock);
}

static void uart_isr(const struct device *dev, void *user_data)
{
	ARG_UNUSED(user_data);

	if (!uart_irq_update(dev)) {
		return;
	}

	while (uart_irq_rx_ready(dev)) {
		uint8_t c;

		if (uart_fifo_read(dev, &c, 1) != 1) {
			break;
		}

		struct improv_rpc cmd;
		enum improv_error err;
		enum improv_parse_result r = improv_serial_feed(&parser, c, &cmd, &err);
		struct serial_msg m;

		if (r == IMPROV_PARSE_RPC_READY) {
			m = (struct serial_msg){ .is_error = false, .cmd = cmd };
		} else if (r == IMPROV_PARSE_ERROR) {
			m = (struct serial_msg){ .is_error = true, .err = err };
		} else {
			continue;
		}

		/* Drop the oldest queued message to make room rather than silently
		 * dropping the newest if the worker is briefly behind.
		 */
		if (k_msgq_put(&serial_msgq, &m, K_NO_WAIT) != 0) {
			struct serial_msg discard;

			(void)k_msgq_get(&serial_msgq, &discard, K_NO_WAIT);
			(void)k_msgq_put(&serial_msgq, &m, K_NO_WAIT);
			LOG_WRN("serial msgq full; dropped an older message");
		}
	}
}

static void worker(void *a, void *b, void *c)
{
	ARG_UNUSED(a);
	ARG_UNUSED(b);
	ARG_UNUSED(c);

	for (;;) {
		struct serial_msg m;

		k_msgq_get(&serial_msgq, &m, K_FOREVER);

		if (m.is_error) {
			improv_handler_report_error(m.err);
		} else {
			improv_handler_on_command(&m.cmd);
		}
	}
}

K_THREAD_DEFINE(improv_serial_worker, WORKER_STACK_SIZE, worker, NULL, NULL, NULL,
		WORKER_PRIORITY, 0, 0);

int improv_serial_init(void)
{
	if (!device_is_ready(uart_dev)) {
		LOG_ERR("console UART not ready");
		return -ENODEV;
	}

	k_mutex_init(&tx_lock);

	uart_irq_callback_user_data_set(uart_dev, uart_isr, NULL);
	uart_irq_rx_enable(uart_dev);

	improv_handler_register_transport(serial_send);

	LOG_INF("improv serial transport ready on %s", uart_dev->name);
	return 0;
}
```

## src/wifi_prov.c
```c
/*
 * wifi_prov.c - Zephyr Wi-Fi management glue for improv.
 *
 * SPDX-License-Identifier: Apache-2.0
 */

#include "wifi_prov.h"

#include <errno.h>
#include <string.h>

#include <zephyr/kernel.h>
#include <zephyr/logging/log.h>
#include <zephyr/net/net_if.h>
#include <zephyr/net/net_ip.h>
#include <zephyr/net/net_mgmt.h>
#include <zephyr/net/wifi.h>
#include <zephyr/net/wifi_mgmt.h>

#if defined(CONFIG_WIFI_CREDENTIALS)
#include <zephyr/net/wifi_credentials.h>
#endif

#include "improv_handler.h"

LOG_MODULE_REGISTER(wifi_prov, LOG_LEVEL_INF);

#define WIFI_EVENTS                                                                                \
	(NET_EVENT_WIFI_CONNECT_RESULT | NET_EVENT_WIFI_DISCONNECT_RESULT |                         \
	 NET_EVENT_WIFI_SCAN_RESULT | NET_EVENT_WIFI_SCAN_DONE)
#define IPV4_EVENTS (NET_EVENT_IPV4_ADDR_ADD)

static struct net_mgmt_event_callback wifi_cb;
static struct net_mgmt_event_callback ipv4_cb;

static wifi_prov_scan_result_cb scan_cb;
static wifi_prov_scan_done_cb scan_done_cb;

/* Credentials of the in-flight client request, persisted once it connects. */
static struct {
	uint8_t ssid[IMPROV_MAX_SSID_LEN + 1];
	uint8_t ssid_len;
	uint8_t psk[IMPROV_MAX_PASSWORD_LEN + 1];
	uint8_t psk_len;
	bool pending;
} attempt;

static struct net_if *wifi_iface(void)
{
	struct net_if *iface = net_if_get_wifi_sta();

	return iface ? iface : net_if_get_first_wifi();
}

#if defined(CONFIG_WIFI_CREDENTIALS)
static void save_credentials(void)
{
	enum wifi_security_type type =
		attempt.psk_len ? WIFI_SECURITY_TYPE_PSK : WIFI_SECURITY_TYPE_NONE;

	/* Single-slot provisioning: replace any previous network. */
	(void)wifi_credentials_delete_all();

	int err = wifi_credentials_set_personal((const char *)attempt.ssid, attempt.ssid_len,
						type, NULL, 0, (const char *)attempt.psk,
						attempt.psk_len, 0, 0, 0);
	if (err) {
		LOG_WRN("failed to persist credentials: %d", err);
	} else {
		LOG_INF("credentials stored for '%s'", (const char *)attempt.ssid);
	}
}
#endif

static void wifi_event(struct net_mgmt_event_callback *cb, uint64_t mgmt_event,
		       struct net_if *iface)
{
	ARG_UNUSED(iface);

	switch (mgmt_event) {
	case NET_EVENT_WIFI_CONNECT_RESULT: {
		const struct wifi_status *st = (const struct wifi_status *)cb->info;
		bool ok = (st != NULL && st->status == 0);

		if (ok && attempt.pending) {
#if defined(CONFIG_WIFI_CREDENTIALS)
			save_credentials();
#endif
		}
		if (!ok) {
			attempt.pending = false;
		}
		improv_handler_on_connect_result(ok);
		break;
	}
	case NET_EVENT_WIFI_DISCONNECT_RESULT:
		LOG_INF("Wi-Fi disconnected");
		break;
	case NET_EVENT_WIFI_SCAN_RESULT: {
		const struct wifi_scan_result *entry =
			(const struct wifi_scan_result *)cb->info;

		/* entry->ssid is length-delimited, not guaranteed NUL-terminated;
		 * copy into a bounded, terminated buffer before handing it on.
		 */
		if (scan_cb && entry != NULL && entry->ssid_length > 0) {
			char ssid[WIFI_SSID_MAX_LEN + 1];
			uint8_t len = MIN(entry->ssid_length, WIFI_SSID_MAX_LEN);

			memcpy(ssid, entry->ssid, len);
			ssid[len] = '\0';
			scan_cb(ssid, entry->rssi,
				entry->security != WIFI_SECURITY_TYPE_NONE);
		}
		break;
	}
	case NET_EVENT_WIFI_SCAN_DONE:
		if (scan_done_cb) {
			scan_done_cb();
		}
		scan_cb = NULL;
		scan_done_cb = NULL;
		break;
	default:
		break;
	}
}

static void ipv4_event(struct net_mgmt_event_callback *cb, uint64_t mgmt_event,
		       struct net_if *iface)
{
	ARG_UNUSED(cb);
	ARG_UNUSED(iface);

	if (mgmt_event != NET_EVENT_IPV4_ADDR_ADD) {
		return;
	}

	char ip[NET_IPV4_ADDR_LEN];

	if (wifi_prov_get_ip(ip, sizeof(ip))) {
		attempt.pending = false;
		improv_handler_on_got_ip(ip);
	}
}

void wifi_prov_init(void)
{
	net_mgmt_init_event_callback(&wifi_cb, wifi_event, WIFI_EVENTS);
	net_mgmt_add_event_callback(&wifi_cb);

	net_mgmt_init_event_callback(&ipv4_cb, ipv4_event, IPV4_EVENTS);
	net_mgmt_add_event_callback(&ipv4_cb);

#if defined(CONFIG_WIFI_CREDENTIALS)
	/* Auto-connect to a stored network on boot, if any. */
	struct net_if *iface = wifi_iface();

	if (iface && !wifi_credentials_is_empty()) {
		LOG_INF("connecting using stored credentials");
		int err = net_mgmt(NET_REQUEST_WIFI_CONNECT_STORED, iface, NULL, 0);

		if (err) {
			LOG_WRN("connect-stored request failed: %d", err);
		}
	}
#endif
}

bool wifi_prov_is_connected(void)
{
	struct net_if *iface = wifi_iface();
	struct wifi_iface_status status = { 0 };

	if (!iface) {
		return false;
	}

	if (net_mgmt(NET_REQUEST_WIFI_IFACE_STATUS, iface, &status, sizeof(status))) {
		return false;
	}

	return status.state >= WIFI_STATE_ASSOCIATED;
}

bool wifi_prov_get_ip(char *buf, size_t buf_len)
{
	struct net_if *iface = wifi_iface();

	if (!iface) {
		return false;
	}

	struct net_in_addr *addr = net_if_ipv4_get_global_addr(iface, NET_ADDR_PREFERRED);

	if (!addr) {
		return false;
	}

	return net_addr_ntop(NET_AF_INET, addr, buf, buf_len) != NULL;
}

int wifi_prov_connect(const uint8_t *ssid, uint8_t ssid_len, const uint8_t *psk, uint8_t psk_len)
{
	struct net_if *iface = wifi_iface();

	if (!iface) {
		LOG_ERR("no Wi-Fi interface");
		return -ENODEV;
	}

	if (ssid == NULL || ssid_len == 0 || ssid_len > IMPROV_MAX_SSID_LEN) {
		return -EINVAL;
	}
	if (psk_len > IMPROV_MAX_PASSWORD_LEN || (psk_len > 0 && psk == NULL)) {
		return -EINVAL;
	}

	/* Remember the attempt so we can persist it once connected. */
	memcpy(attempt.ssid, ssid, ssid_len);
	attempt.ssid[ssid_len] = '\0';
	attempt.ssid_len = ssid_len;
	if (psk_len > 0) {
		memcpy(attempt.psk, psk, psk_len);
	}
	attempt.psk[psk_len] = '\0';
	attempt.psk_len = psk_len;
	attempt.pending = true;

	struct wifi_connect_req_params params = {
		.ssid = attempt.ssid,
		.ssid_length = ssid_len,
		.psk = psk_len ? attempt.psk : NULL,
		.psk_length = psk_len,
		.security = psk_len ? WIFI_SECURITY_TYPE_PSK : WIFI_SECURITY_TYPE_NONE,
		.channel = WIFI_CHANNEL_ANY,
		.band = WIFI_FREQ_BAND_UNKNOWN,
		.mfp = WIFI_MFP_OPTIONAL,
		.timeout = SYS_FOREVER_MS,
	};

	LOG_INF("connecting to '%s'", (const char *)attempt.ssid);

	int err = net_mgmt(NET_REQUEST_WIFI_CONNECT, iface, &params, sizeof(params));

	if (err) {
		attempt.pending = false;
		LOG_ERR("connect request failed: %d", err);
	}

	return err;
}

int wifi_prov_scan(wifi_prov_scan_result_cb result_cb, wifi_prov_scan_done_cb done_cb)
{
	struct net_if *iface = wifi_iface();

	if (!iface) {
		return -ENODEV;
	}

	scan_cb = result_cb;
	scan_done_cb = done_cb;

	int err = net_mgmt(NET_REQUEST_WIFI_SCAN, iface, NULL, 0);

	if (err) {
		scan_cb = NULL;
		scan_done_cb = NULL;
		LOG_ERR("scan request failed: %d", err);
	}

	return err;
}
```

## src/wifi_prov.h
```c
/*
 * wifi_prov.h - Zephyr Wi-Fi management glue for improv.
 *
 * Wraps the net_mgmt Wi-Fi API: connecting with SSID/PSK, reporting connection
 * and DHCP results, scanning, and persisting credentials via the wifi_credentials
 * library. Results are delivered asynchronously to the improv handler.
 *
 * SPDX-License-Identifier: Apache-2.0
 */

#ifndef WIFI_PROV_H_
#define WIFI_PROV_H_

#include <stdbool.h>
#include <stddef.h>
#include <stdint.h>

/* Per-network result for a scan, and a terminator callback. */
typedef void (*wifi_prov_scan_result_cb)(const char *ssid, int8_t rssi, bool secured);
typedef void (*wifi_prov_scan_done_cb)(void);

/* Initialise networking event handling. Must be called once at boot. */
void wifi_prov_init(void);

/* True if the Wi-Fi interface currently has an association. */
bool wifi_prov_is_connected(void);

/* Copy the current IPv4 address as a dotted string. Returns false if none. */
bool wifi_prov_get_ip(char *buf, size_t buf_len);

/*
 * Start an asynchronous connection attempt. The result arrives via
 * improv_handler_on_connect_result(); on success the obtained IP arrives via
 * improv_handler_on_got_ip(). On success the credentials are persisted.
 * Returns 0 if the request was accepted.
 */
int wifi_prov_connect(const uint8_t *ssid, uint8_t ssid_len, const uint8_t *psk,
		      uint8_t psk_len);

/*
 * Start an asynchronous scan. @result_cb is invoked once per network and
 * @done_cb once when the scan completes. Returns 0 if the request was accepted.
 */
int wifi_prov_scan(wifi_prov_scan_result_cb result_cb, wifi_prov_scan_done_cb done_cb);

#endif /* WIFI_PROV_H_ */
```
