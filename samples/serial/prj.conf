## CMakeLists.txt
```
# SPDX-License-Identifier: Apache-2.0
cmake_minimum_required(VERSION 3.20.0)

find_package(Zephyr REQUIRED HINTS $ENV{ZEPHYR_BASE})
project(improv_serial LANGUAGES C)

target_sources(app PRIVATE src/main.c)
```

## prj.conf
```kconfig
# Improv-WiFi serial sample (JS Web Serial). Serial is the default transport.

# Improv module
CONFIG_IMPROV_WIFI=y
CONFIG_IMPROV_SERIAL=y

# Wi-Fi + networking
CONFIG_WIFI=y
CONFIG_NETWORKING=y
CONFIG_NET_IPV4=y
CONFIG_NET_IPV6=n
CONFIG_NET_DHCPV4=y
CONFIG_NET_MGMT=y
CONFIG_NET_MGMT_EVENT=y
CONFIG_NET_MGMT_EVENT_INFO=y
CONFIG_NET_L2_WIFI_MGMT=y

# Wi-Fi credentials library (persist + connect-stored on boot)
CONFIG_WIFI_NM=y
CONFIG_WIFI_CREDENTIALS=y
CONFIG_WIFI_CREDENTIALS_BACKEND_SETTINGS=y
CONFIG_WIFI_CREDENTIALS_CONNECT_STORED=y

# Persistence backend (NVS via the settings subsystem on storage_partition)
CONFIG_SETTINGS=y
CONFIG_FLASH=y
CONFIG_FLASH_MAP=y
CONFIG_NVS=y
CONFIG_SETTINGS_NVS=y

# Serial console (improv frames + logs share this UART). Shell stays off so it
# does not consume RX.
CONFIG_SERIAL=y
CONFIG_CONSOLE=y
CONFIG_UART_CONSOLE=y
CONFIG_UART_INTERRUPT_DRIVEN=y

# Optional identify LED
CONFIG_GPIO=y

# Logging
CONFIG_LOG=y
CONFIG_LOG_DEFAULT_LEVEL=3

CONFIG_MAIN_STACK_SIZE=4096
CONFIG_SYSTEM_WORKQUEUE_STACK_SIZE=2048
```

## boards/esp32s3_devkitc_procpu.conf
```kconfig
# Headroom for the networking stacks on esp32s3 (the ESP32 Wi-Fi driver
# auto-enables and adds its own heap).
CONFIG_NET_PKT_RX_COUNT=16
CONFIG_NET_PKT_TX_COUNT=16
CONFIG_NET_BUF_RX_COUNT=32
CONFIG_NET_BUF_TX_COUNT=32
```

## src/main.c
```c
/*
 * Improv-WiFi serial provisioning sample.
 *
 * Brings up improv over the console UART (the default transport). Provision with
 * the Web Serial installer at https://www.improv-wifi.com/serial/.
 *
 * SPDX-License-Identifier: Apache-2.0
 */

#include <zephyr/kernel.h>

#include <improv/improv_wifi.h>

int main(void)
{
	improv_wifi_init();
	return 0;
}
```
